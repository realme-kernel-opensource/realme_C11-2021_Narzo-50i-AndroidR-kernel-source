## drivers/input/touchscreen/ICNL9911/Kconfig
```kconfig
config TOUCHSCREEN_CTS
    bool "Cts Touchscreen"
    default n
    depends on TOUCHSCREEN_CTS_CHIPSET
    help
      Say Y here if you have CTS touch panel.
      If unsure, say N.
      

    
```

## drivers/misc/device_info/Kconfig
```kconfig
config OPLUS_DEVICE_IFNO
	bool "config oppo devinfo software"
	default y
	help
		define this config to compile devinfo.c for device register
```
